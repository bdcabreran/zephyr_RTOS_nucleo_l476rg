## CMakeLists.txt
```
# SPDX-License-Identifier: Apache-2.0

cmake_minimum_required(VERSION 3.13.1)
set(BOARD nucleo_l476rg)
set(DTC_OVERLAY_FILE board/nucleo_l476rg.overlay)
find_package(Zephyr REQUIRED HINTS $ENV{ZEPHYR_BASE})
project(zephyr_RTOS_nucleo_l476rg)

add_subdirectory(src)
target_include_directories(app
    PUBLIC 
        inc
)
```

## sample.yaml
```
sample:
  name: nucleo_project
tests:
  sample.basic.blinky:
    tags: LED gpio
    filter: dt_compat_enabled_with_alias("gpio-leds", "led0")
    filter: dt_alias_exists("pwm-led0")
    depends_on: gpio
    depends_on: pwm
    harness: led
    integration_platforms:
      - frdm_k64f
sample:
  description: TBD
  name: TBD
tests:
  sample.bluetooth.st_ble_sensor:
    harness: bluetooth
    platform_allow: nucleo_wb55rg
    tags: bluetooth
```

## prj.conf
```kconfig
# Kconfig
CONFIG_GPIO=y
CONFIG_STDOUT_CONSOLE=y
CONFIG_PRINTK=y
CONFIG_PWM=y
CONFIG_LOG=y
CONFIG_LOG_PRINTK=y
CONFIG_LOG_IMMEDIATE=y
CONFIG_PWM_LOG_LEVEL_DBG=y

#Configuration for FAT
CONFIG_DISK_ACCESS_SDHC=y
CONFIG_DISK_ACCESS_SPI_SDHC=y
CONFIG_SPI=y
CONFIG_SPI_1=y
CONFIG_DISK_ACCESS=y
CONFIG_FILE_SYSTEM=y
CONFIG_FAT_FILESYSTEM_ELM=y
CONFIG_MAIN_STACK_SIZE=2048

#Cpp configuration
CONFIG_LIB_CPLUSPLUS=y
CONFIG_NEWLIB_LIBC=y
CONFIG_CPLUSPLUS=y
CONFIG_STD_CPP14=y
```

## src/main.c
```c
/*
 * Copyright (c) 2016 Intel Corporation
 *
 * SPDX-License-Identifier: Apache-2.0
 */
#include "main.h"
#include "heartbeat.h"
#include "pwm_led.h"
#include "fat_fs.h"

LOG_MODULE_REGISTER(main);

void main(void)
{
	printk("Nucleo Project\n");
	
	heartbeat_setup();
	pwm_led_setup();
	sd_card_init();
	
	while (1)
	{
		heartbeat_exec();
		//pwm_led_exec();
	}
}
```

## inc/fat_fs.h
```c
#ifndef FAT_FS_H
#define FAT_FS_H

#include <logging/log.h>
#include <disk/disk_access.h>
#include <fs/fs.h>
#include <ff.h>

void sd_card_init(void);

#endif
```

## inc/heartbeat.h
```c
#ifndef HEARTBEAT_H_
#define HEARTBEAT_H_

#include <drivers/gpio.h>

/* 1000 msec = 1 sec */
#define SLEEP_TIME_MS   20

/* The devicetree node identifier for the "led0" alias. */
#define LED0_NODE DT_ALIAS(led0)

#if DT_NODE_HAS_STATUS(LED0_NODE, okay)
#define LED0	DT_GPIO_LABEL(LED0_NODE, gpios)
#define PIN	DT_GPIO_PIN(LED0_NODE, gpios)
#define FLAGS	DT_GPIO_FLAGS(LED0_NODE, gpios)
#else
/* A build error here means your board isn't set up to blink an LED. */
#error "Unsupported board: led0 devicetree alias is not defined"
#define LED0	""
#define PIN	0
#define FLAGS	0
#endif

extern const struct device *dev;
int heartbeat_exec(void);
int heartbeat_setup(void);

#endif
```

## inc/main.h
```c
#ifndef MAIN_H_
#define MAIN_H_

#include <zephyr.h>
#include <device.h>
#include <devicetree.h>
#include <sys/printk.h>


#endif /* MAIN_H_ */
```

## inc/pwm_led.h
```c
#ifndef PWM_LED_H
#define PWM_LED_H

#include <drivers/gpio.h>
#include <drivers/pwm.h>
#include <sys/printk.h>

#define PWM_LED0_NODE	DT_ALIAS(pwm_led0)

#if DT_NODE_HAS_STATUS(PWM_LED0_NODE, okay)
#define PWM_LABEL	DT_PWMS_LABEL(PWM_LED0_NODE)
#define PWM_CHANNEL	DT_PWMS_CHANNEL(PWM_LED0_NODE)
#define PWM_FLAGS	DT_PWMS_FLAGS(PWM_LED0_NODE)
#else
#error "Unsupported board: pwm-led0 devicetree alias is not defined"
#define PWM_LABEL	""
#define PWM_CHANNEL	0
#define PWM_FLAGS	0
#endif

#define MIN_PERIOD_USEC	(USEC_PER_SEC / 64U)
#define MAX_PERIOD_USEC	USEC_PER_SEC

extern const struct device *pwm;
int pwm_led_setup(void);
int pwm_led_exec(void);


#endif
```

## src/fat_fs.c
```c
#include "fat_fs.h"

LOG_MODULE_REGISTER(fat_fs);

static int lsdir(const char *path);

static FATFS fat_fs;
/* mounting info */
static struct fs_mount_t mp = {
	.type = FS_FATFS,
	.fs_data = &fat_fs,
};

/*
*  Note the fatfs library is able to mount only strings inside _VOLUME_STRS
*  in ffconf.h
*/
static const char *disk_mount_pt = "/SD:";

void sd_card_init(void)
{
	/* raw disk i/o */
	do {
		static const char *disk_pdrv = "SD";
		uint64_t memory_size_mb;
		uint32_t block_count;
		uint32_t block_size;

		if (disk_access_init(disk_pdrv) != 0) {
			LOG_ERR("Storage init ERROR!");
			break;
		}

		if (disk_access_ioctl(disk_pdrv,
				DISK_IOCTL_GET_SECTOR_COUNT, &block_count)) {
			LOG_ERR("Unable to get sector count");
			break;
		}
		LOG_INF("Block count %u", block_count);

		if (disk_access_ioctl(disk_pdrv,
				DISK_IOCTL_GET_SECTOR_SIZE, &block_size)) {
			LOG_ERR("Unable to get sector size");
			break;
		}
		printk("Sector size %u\n", block_size);

		memory_size_mb = (uint64_t)block_count * block_size;
		printk("Memory Size(MB) %u\n", (uint32_t)(memory_size_mb >> 20));
	} while (0);

	mp.mnt_point = disk_mount_pt;

	int res = fs_mount(&mp);

	if (res == FR_OK) {
		printk("Disk mounted.\n");
		lsdir(disk_mount_pt);
	} else {
		printk("Error mounting disk.\n");
	}
}


static int lsdir(const char *path)
{
	int res;
	struct fs_dir_t dirp;
	static struct fs_dirent entry;

	/* Verify fs_opendir() */
	res = fs_opendir(&dirp, path);
	if (res) {
		printk("Error opening dir %s [%d]\n", path, res);
		return res;
	}

	printk("\nListing dir %s ...\n", path);
	for (;;) {
		/* Verify fs_readdir() */
		res = fs_readdir(&dirp, &entry);

		/* entry.name[0] == 0 means end-of-dir */
		if (res || entry.name[0] == 0) {
			break;
		}

		if (entry.type == FS_DIR_ENTRY_DIR) {
			printk("[DIR ] %s\n", entry.name);
		} else {
			printk("[FILE] %s (size = %zu)\n",
				entry.name, entry.size);
		}
	}

	/* Verify fs_closedir() */
	fs_closedir(&dirp);

	return res;
}
```

## src/heartbeat.c
```c
#include "heartbeat.h"
#include <logging/log.h>

LOG_MODULE_REGISTER(heartbeat);

const struct device *dev;

int heartbeat_setup(void)
{
	LOG_INF("Initializing Hearbeat...\r\n");

	int ret;
	dev = device_get_binding(LED0);
	if (dev == NULL) {
		return 0;
	}
	ret = gpio_pin_configure(dev, PIN, GPIO_OUTPUT_ACTIVE | FLAGS);
	if (ret < 0) {
		return 0;
	}
}

int heartbeat_exec(void)
{
	static bool led_is_on = true;
	gpio_pin_set(dev, PIN, (int)led_is_on);
	led_is_on = !led_is_on;
	k_msleep(SLEEP_TIME_MS);
}
```

## src/pwm_led.c
```c
#include "pwm_led.h"

const struct device *pwm;
static uint32_t max_period;
static uint32_t period;
static uint8_t dir = 0U;

int pwm_led_setup(void)
{
	printk("PWM-based blinky Setup\n");

	pwm = device_get_binding(PWM_LABEL);
	if (!pwm) {
		printk("Error: didn't find %s device\n", PWM_LABEL);
		return 0;
	}

    /*
	 * In case the default MAX_PERIOD_USEC value cannot be set for
	 * some PWM hardware, decrease its value until it can.
	 *
	 * Keep its value at least MIN_PERIOD_USEC * 4 to make sure
	 * the sample changes frequency at least once.
	 */
	printk("Calibrating for device %s channel %d...\n", PWM_LABEL, PWM_CHANNEL);
	max_period = MAX_PERIOD_USEC;
	
    while (pwm_pin_set_usec(pwm, PWM_CHANNEL,
				max_period, max_period / 2U, PWM_FLAGS)) {
		max_period /= 2U;
		if (max_period < (4U * MIN_PERIOD_USEC)) {
			printk("Error: PWM device %s "
			       "does not support a period at least %u\n",
			       PWM_LABEL, 4U * MIN_PERIOD_USEC);
			return;
		}
	}

	printk("Done calibrating; maximum/minimum periods %u/%u usec\n",
	       max_period, MIN_PERIOD_USEC);

	period = max_period;
}

int pwm_led_exec(void)
{
    int ret;

    ret = pwm_pin_set_usec(pwm, PWM_CHANNEL, period, period / 2U, PWM_FLAGS);

    if (ret)
    {
        printk("Error %d: failed to set pulse width\n", ret);
        return 0;
    }

    period = dir ? (period * 2U) : (period / 2U);
    if (period > max_period)
    {
        period = max_period / 2U;
        dir = 0U;
    }
    else if (period < MIN_PERIOD_USEC)
    {
        period = MIN_PERIOD_USEC * 2U;
        dir = 1U;
    }

    k_sleep(K_SECONDS(4U));
}
```
